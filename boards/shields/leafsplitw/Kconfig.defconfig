## boards/shields/leafsplitw/Kconfig.defconfig
```kconfig
if SHIELD_LEAFSPLITW_LEFT

# Name must be less than 16 characters long!
config ZMK_KEYBOARD_NAME
	default "leaf/split w"

config ZMK_SPLIT_ROLE_CENTRAL
	default y
endif

if SHIELD_LEAFSPLITW_LEFT || SHIELD_LEAFSPLITW_RIGHT

config ZMK_SPLIT
	default y

endif
```

## boards/shields/leafsplitw/Kconfig.shield
```kconfig
config SHIELD_LEAFSPLITW_LEFT
	def_bool $(shields_list_contains,leafsplitw_left)

config SHIELD_LEAFSPLITW_RIGHT
	def_bool $(shields_list_contains,leafsplitw_right)
```
