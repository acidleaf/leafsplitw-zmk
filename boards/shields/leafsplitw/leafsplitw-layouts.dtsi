#include <physical_layouts.dtsi>

/ {
    physical_layout0: physical_layout_0 {
        compatible = "zmk,physical-layout";
        display-name = "Default Layout";
    };

    leafsplitw_position_map {
        compatible = "zmk,physical-layout-position-map";
        complete;

        twelve {
            physical-layout = <&physical_layout0>;
            positions = 
                < 0  1  2  3  4  5     6  7  8  9 10 11>,
                <12 13 14 15 16 17    18 19 20 21 22 23>,
                <24 25 26 27 28 29    30 31 32 33 34 35>,
                <         36 37 38    39 40 41>;
        };
    };
};